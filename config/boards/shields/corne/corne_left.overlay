&kscan0 {
    col-gpios
        = <&gpio0 9 GPIO_ACTIVE_HIGH>       // Column 0 - TAB, CTRL, SHIFT (P0.09)
        , <&gpio0 10 GPIO_ACTIVE_HIGH>      // Column 1 - Q, A, Z (P0.10)
        , <&pro_micro 19 GPIO_ACTIVE_HIGH>  // Column 2 - W, S, X
        , <&pro_micro 18 GPIO_ACTIVE_HIGH>  // Column 3 - E, D, C
        , <&pro_micro 15 GPIO_ACTIVE_HIGH>  // Column 4 - R, F, V
        , <&pro_micro 14 GPIO_ACTIVE_HIGH>  // Column 5 - T, G, B
        ;
};